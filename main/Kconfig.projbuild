## main/Kconfig.projbuild
```kconfig
menu "Tomato Glow Clock"

config TOMATO_WIFI_SSID
    string "WiFi SSID"
    default ""
    help
        WiFi network name used by Tomato Glow Clock for time sync and weather.

config TOMATO_WIFI_PASS
    string "WiFi password"
    default ""
    help
        WiFi password. Leave empty for an open network.

config TOMATO_QWEATHER_API_KEY
    string "Legacy QWeather API key"
    default ""
    help
        Kept only for old API key credentials. Tomato Glow Clock now uses local JWT
        signing when main/APP/qweather_jwt_secret.h is present.

config TOMATO_QWEATHER_LOCATION
    string "QWeather location"
    default "113.53,22.49"
    help
        QWeather location ID or longitude,latitude. Default is Zhongshan Nanlang.

endmenu

menu "Network Radio"

config RADIO_BOARD_ES8388_HEADLESS
    bool "Enable onboard ES8388 headless Radio"
    default y
    help
        Use the onboard ES8388 and speaker after the RGB LCD has been shut down
        and its conflicting GPIOs have been released.

config RADIO_EXTERNAL_I2S_DAC
    bool "Enable external I2S DAC for Radio"
    default n
    depends on !RADIO_BOARD_ES8388_HEADLESS
    help
        Enable this only after wiring an external I2S DAC to free GPIOs.
        The onboard ES8388 path conflicts with the 4.3 inch RGB LCD pins.

config RADIO_I2S_BCLK_GPIO
    int "Radio external I2S BCLK GPIO"
    range 0 48
    default 35
    depends on RADIO_EXTERNAL_I2S_DAC

config RADIO_I2S_LRCK_GPIO
    int "Radio external I2S LRCK/WS GPIO"
    range 0 48
    default 36
    depends on RADIO_EXTERNAL_I2S_DAC

config RADIO_I2S_DOUT_GPIO
    int "Radio external I2S DOUT GPIO"
    range 0 48
    default 37
    depends on RADIO_EXTERNAL_I2S_DAC

config RADIO_I2S_MCLK_GPIO
    int "Radio external I2S MCLK GPIO (-1 disabled)"
    range -1 48
    default -1
    depends on RADIO_EXTERNAL_I2S_DAC

endmenu
```
